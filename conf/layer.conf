## conf/layer.conf
```bitbake
# We have a conf and classes directory, add to BBPATH
BBPATH .= ":${LAYERDIR}"

# We have recipes-* directories, add to BBFILES
BBFILES += "${LAYERDIR}/recipes-*/*/*.bb \
            ${LAYERDIR}/recipes-*/*/*.bbappend"

BBFILE_COLLECTIONS += "meta-odroid-u3"
BBFILE_PATTERN_meta-odroid-u3 = "^${LAYERDIR}/"
BBFILE_PRIORITY_meta-odroid-u3 = "6"

LAYERDEPENDS_meta-odroid-u3 = "core"
LAYERSERIES_COMPAT_meta-odroid-u3 = "honister"
```

## conf/machine/odroid-u3.conf
```bitbake
#-----------------------------------------------------------------------------
#@TYPE: Machine
#@NAME: ODROID-U2 (Exynos 4412)
#@DESCRIPTION: Machine configuration for the ODROID-U2 by hardkernel
#-----------------------------------------------------------------------------

#TARGET_ARCH = "arm"

PREFERRED_PROVIDER_virtual/kernel ?= "linux-yocto"

KERNEL_IMAGETYPE = "zImage"
WKS_FILE ?= "sdimage-odroid-u3.wks"
IMAGE_FSTYPES += "tar.gz wic wic.bmap"
IMAGE_BOOT_FILES = "zImage"

require conf/machine/include/arm/arch-armv7a.inc
```
